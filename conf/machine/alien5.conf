## conf/machine/alien5.conf
```bitbake
#@TYPE: Machine
#@NAME: 
#@DESCRIPTION: Machine configuration for the Amiko Alien5

SOC_FAMILY = "AML905D"

require conf/machine/include/linkdroid.inc

PREFERRED_PROVIDER_virtual/kernel = "linux-linkdroid"
PREFERRED_VERSION_linux-linkdroid = "3.14.29"

MACHINEKERNEL = "linkdroid"

KERNEL_DEVICETREE = "alien5.dtb"

KERNEL_MODULE_AUTOLOAD += "\
    se2io_se \
    ampanel \
    a5stb \
    mali \
    rfcomm \
    hidp \
    bluetooth \
    6lowpan-iphc \
    libcrc32c \
    mceusb \
    rc-core \
    cfg80211 \
    8189es \
"
```

## conf/machine/include/amlogic-meson.inc
```bitbake
# Amlogic Meson SoCs configurations

IMAGE_CLASSES += "image_types_meson"

MACHINE_EXTRA_RRECOMMENDS = "kernel-modules kernel-devicetree"

SERIAL_CONSOLE = "115200 ttyAML0"

KERNEL_IMAGETYPE = "uImage"
UBOOT_LOADADDRESS = "0x1080000"
UBOOT_ENTRYSYMBOL = "0x1080000"

IMAGE_BOOT_FILES ?= "uImage"

IMAGE_ROOTFS_SIZE = "1048576"
IMAGE_FSTYPES = "ext4 sdcard"
WKS_FILE = "sdimage-bootpart.wks"
do_image_wic[depends] += "mtools-native:do_populate_sysroot dosfstools-native:do_populate_sysroot"

IMAGE_CMD_sdcard_append = " \
    mkdir -p ${DEPLOY_DIR_IMAGE}/${IMAGEDIR}; \
    mv ${DEPLOY_DIR_IMAGE}/${IMAGE_NAME}.rootfs.meson-sd.img ${DEPLOY_DIR_IMAGE}/${IMAGEDIR}/${IMAGE_NAME}.sdcard.img; \
    echo ${IMAGE_VER_STRING} > ${DEPLOY_DIR_IMAGE}/${IMAGEDIR}/imageversion; \
    cd ${DEPLOY_DIR_IMAGE}; \
    zip ${IMAGE_NAME}_sdcard.zip ${IMAGEDIR}/*; \
    rm -f ${DEPLOY_DIR_IMAGE}/*.ext4; \
    rm -f ${DEPLOY_DIR_IMAGE}/*.manifest; \
    rm -f ${DEPLOY_DIR_IMAGE}/.ext4; \
    rm -f ${DEPLOY_DIR_IMAGE}/.manifest; \
    rm -f ${DEPLOY_DIR_IMAGE}/.meson-sd.img; \
    rm -f ${DEPLOY_DIR_IMAGE}/*.rootfs.meson-sd.img; \
    rm -Rf ${IMAGEDIR}; \
    "
```

## conf/machine/include/wetek-amlogic.inc
```bitbake
IMAGE_CLASSES += "image_types_wetek"

GST_VERSION = "0.10"

DVBPROVIDER = "kernel"
DVBSKYPROVIDER = "kernel"

IMAGEDIR ?= "${MACHINE}"

MACHINE_EXTRA_RRECOMMENDS += "\
    libamplayer \
    libamavutils \
    libamadec \
    libamcodec \
    "

IMAGE_FSTYPES += "ext4 sdcard"
IMAGE_ROOTFS_SIZE = "976562"
IMAGE_EXTRA_SPACE = "0"
IMAGE_OVERHEAD_FACTOR = "1.0"

# Serial console to be used
SERIAL_CONSOLE = "115200 ttyS0"

UBOOT_ENTRYPOINT  = "0x80008000"
UBOOT_LOADADDRESS = "0x80008000"

IMAGE_CMD_sdcard_append = "\
    mkdir -p ${DEPLOY_DIR_IMAGE}/${IMAGEDIR}; \
    mv ${DEPLOY_DIR_IMAGE}/${IMAGE_NAME}.rootfs.wetek-sd.img ${DEPLOY_DIR_IMAGE}/${IMAGEDIR}/${IMAGE_NAME}.sdcard.img; \
    echo ${IMAGE_VER_STRING} > ${DEPLOY_DIR_IMAGE}/${IMAGEDIR}/imageversion; \
    cd ${DEPLOY_DIR_IMAGE}; \
    zip ${IMAGE_NAME}_sdcard.zip ${IMAGEDIR}/*; \
    rm -f ${DEPLOY_DIR_IMAGE}/*.ext4; \
    rm -f ${DEPLOY_DIR_IMAGE}/*.manifest; \
    rm -f ${DEPLOY_DIR_IMAGE}/.ext4; \
    rm -f ${DEPLOY_DIR_IMAGE}/.manifest; \
    rm -f ${DEPLOY_DIR_IMAGE}/.wetek-sd.img; \
    rm -f ${DEPLOY_DIR_IMAGE}/*.rootfs.wetek-sd.img; \
    rm -Rf ${IMAGEDIR}; \
    "

MACHINE_FEATURES += "wlan bluetooth fb usbhost vfat alsa dvb-c nolcd wetek-pli"

PREFERRED_PROVIDER_virtual/libgles1 = "opengl-amlogic"
PREFERRED_PROVIDER_virtual/libgles2 = "opengl-amlogic"
PREFERRED_PROVIDER_virtual/egl = "opengl-amlogic"

PREFERRED_PROVIDER_jpeg = "libjpeg-turbo"
PREFERRED_PROVIDER_jpeg-native = "libjpeg-turbo-native"

EXTRA_OECONF_append_pn-enigma2 = " --with-alsa --with-alsacard=hw:0 --with-alsamixer=Master --with-fbdev=/dev/fb2 --with-lcddev=/dev/null --with-amlogic"
DEPENDS_append_pn-enigma2 = " libdvbcsa libamcodec libamadec"
EXTRA_OECONF_append_pn-tuxtxt-enigma2 = " --with-fbdev=/dev/fb2"
CC_append_pn-showiframe = " -DHAVE_AMLOGIC -I${STAGING_INCDIR}/amlogic/amcodec -lamcodec"
DEPENDS_append_pn-showiframe = " libamcodec"

include conf/machine/include/autoload-filesystems.inc

# We know about rtc
include conf/machine/include/build-extras.inc
```

## conf/machine/k1plus.conf
```bitbake
#@TYPE: Machine
#@NAME: 
#@DESCRIPTION: Machine configuration for the Mecool K1 Plus

SOC_FAMILY = "AML905"

require conf/machine/include/mecool.inc

KERNEL_DEVICETREE = "gxbb_p200_k1_plus.dtb"
```

## conf/machine/k1pro.conf
```bitbake
#@TYPE: Machine
#@NAME: 
#@DESCRIPTION: Machine configuration for the Mecool K1 Pro

SOC_FAMILY = "AML905D"

require conf/machine/include/mecool.inc

PREFERRED_PROVIDER_virtual/kernel = "linux-coreelec"
PREFERRED_VERSION_linux-coreelec = "3.14.29%"

MACHINEKERNEL = "coreelec"

KERNEL_DEVICETREE = "gxl_p230_k1_pro.dtb"

KERNEL_MODULE_AUTOLOAD += "\
    e2_procfs \
    mali \
    rfcomm \
    hidp \
    bluetooth \
    6lowpan-iphc \
    libcrc32c \
    mceusb \
    rc-core \
    cfg80211 \
    8189es \
    aml \
    aml_fe \
    avl6862 \
    r848a \
"

MACHINE_ESSENTIAL_EXTRA_RDEPENDS += "\
    kernel-module-aml \
    kernel-module-aml-fe \
    kernel-module-avl6862 \
    kernel-module-r848a \
"
```

## conf/machine/k2pro.conf
```bitbake
#@TYPE: Machine
#@NAME: 
#@DESCRIPTION: Machine configuration for the Mecool K2 Pro (New version)

SOC_FAMILY = "AML905D"

require conf/machine/include/linkdroid.inc

PREFERRED_PROVIDER_virtual/kernel = "linux-mecool"
PREFERRED_VERSION_linux-mecool = "3.14.29"

MACHINEKERNEL = "mecool"

KERNEL_DEVICETREE = "k2pro.dtb"

KERNEL_MODULE_AUTOLOAD += "\
    se2io_se \
    ampanel \
    a5stb \
    mali \
    rfcomm \
    hidp \
    bluetooth \
    6lowpan-iphc \
    libcrc32c \
    mceusb \
    rc-core \
    cfg80211 \
    8189es \
    avl6882 \
"

MACHINE_ESSENTIAL_EXTRA_RDEPENDS += "\
    firmware-avl6882 \
    kernel-module-avl6862 \
    "
```

## conf/machine/k2pro_s905.conf
```bitbake
#@TYPE: Machine
#@NAME: Mecool K2 Pro(S905 soc)
#@DESCRIPTION: Machine configuration for the Mecool K2 Pro (old version)

SOC_FAMILY = "AML905"

require conf/machine/include/mecool.inc

PREFERRED_PROVIDER_virtual/kernel = "linux-coreelec"
PREFERRED_VERSION_linux-coreelec = "3.14.29%"

MACHINEKERNEL = "coreelec"

KERNEL_DEVICETREE = "gxbb_p200_k2_pro.dtb"
#PREFERRED_VERSION_gcc-cross-${TARGET_ARCH} ?= "4.9%"


KERNEL_MODULE_AUTOLOAD += "\
    mali \
    rfcomm \
    hidp \
    bluetooth \
    6lowpan-iphc \
    libcrc32c \
    mceusb \
    rc-core \
    cfg80211 \
    8189es \
    aml \
    aml_fe \
    avl6862 \
    r848a \
"

MACHINE_ESSENTIAL_EXTRA_RDEPENDS += "\
    kernel-module-aml \
    kernel-module-aml-fe \
    kernel-module-avl6862 \
    kernel-module-r848a \
"
```

## conf/machine/k2pro_s905D.conf
```bitbake
#@TYPE: Machine
#@NAME: Mecool K2 Pro(S905D soc)
#@DESCRIPTION: Machine configuration for the Mecool K2 Pro (New version)

SOC_FAMILY = "AML905D"

require conf/machine/include/mecool.inc

PREFERRED_PROVIDER_virtual/kernel = "linux-coreelec"
PREFERRED_VERSION_linux-coreelec = "3.14.29%"

MACHINEKERNEL = "coreelec"

KERNEL_DEVICETREE = "gxl_p230_k1_pro.dtb"

KERNEL_MODULE_AUTOLOAD += "\
    e2_procfs \
    mali \
    rfcomm \
    hidp \
    bluetooth \
    6lowpan-iphc \
    libcrc32c \
    mceusb \
    rc-core \
    cfg80211 \
    8189es \
    aml \
    aml_fe \
    avl6862 \
    r848a \
"

MACHINE_ESSENTIAL_EXTRA_RDEPENDS += "\
    kernel-module-aml \
    kernel-module-aml-fe \
    kernel-module-avl6862 \
    kernel-module-r848a \
"
```

## conf/machine/k3pro.conf
```bitbake
#@TYPE: Machine
#@NAME: 
#@DESCRIPTION: Machine configuration for the Mecool K3 Pro

SOC_FAMILY = "AML912"

require conf/machine/include/mecool.inc

KERNEL_DEVICETREE = "gxm_q200_k3_pro.dtb"

MACHINE_ESSENTIAL_EXTRA_RDEPENDS += "\
    firmware-ap6335-mecool \
    "
```

## conf/machine/odroidc2.conf
```bitbake
#@TYPE: Machine
#@NAME: ODROID-C2
#@DESCRIPTION: Machine configuration for ODROID-C2

GST_VERSION = "0.10"

# Amlogic defaults
require conf/machine/include/amlogic.inc
require conf/machine/include/arm/arch-armv8.inc

DVBPROVIDER = "kernel"

MACHINE_ESSENTIAL_EXTRA_RDEPENDS = "\
    hardkernel-mali-${MACHINE} \
    ${@bb.utils.contains('GST_VERSION', '1.0', 'gst-amlavsink1 ', 'gst-amlavsink gst-amlavout  gst-ffmpeg gst-fluendo-mpegdemux ', d)} \
    \
     \
    opengl-amlogic \
    "

MACHINE_EXTRA_RRECOMMENDS = " \
    libamplayer \
    libamavutils \
    libamadec \
    libamcodec \
    "

KERNEL_MODULE_AUTOLOAD += "\
    e2-procfs \
    sysfillrect \
    syscopyarea \
    mceusb \
    rc-core \
    mali \
    dhd \
    CH341 \
    rfcomm \
    hidp \
    cfg80211 \
    bluetooth \
    6lowpan-iphc \
    libcrc32c \
    xfs \
"
module_conf_dhd = "options dhd firmware_path=/lib/firmware/brcm/ nvram_path=/lib/firmware/brcm/"

KERNEL_MODULE_PROBECONF += "\
	dhd \
"

EXTRA_IMAGEDEPENDS += "u-boot-hardkernel"

SDCARD_ROOTFS ?= "${DEPLOY_DIR_IMAGE}/${IMAGE_NAME}.rootfs.ext4"
IMAGE_FSTYPES ?= "ext4 sdcard"
IMAGEDIR ?= "${MACHINE}"

IMAGE_CMD_sdcard_append  = " \
    mkdir -p ${DEPLOY_DIR_IMAGE}/${IMAGEDIR}; \
    mv ${SDIMG} ${DEPLOY_DIR_IMAGE}/${IMAGEDIR}; \
    echo ${IMAGE_VER_STRING} > ${DEPLOY_DIR_IMAGE}/${IMAGEDIR}/imageversion; \
    cd ${DEPLOY_DIR_IMAGE}; \
    zip ${SDIMG}.zip ${IMAGEDIR}/*; \
    rm -f ${DEPLOY_DIR_IMAGE}/*.ext4; \
    rm -f ${DEPLOY_DIR_IMAGE}/*.manifest; \
    rm -f ${DEPLOY_DIR_IMAGE}/*.rootfs.sdcard.img; \
    rm -f ${DEPLOY_DIR_IMAGE}/.manifest; \
    rm -Rf ${IMAGEDIR}; \
"

SERIAL_CONSOLE = "115200 ttyS0"

PREFERRED_PROVIDER_virtual/kernel ?= "linux-hardkernel"
PREFERRED_VERSION_linux-hardkernel ?= "3.14%"

#specify u-boot parameters
PREFERRED_PROVIDER_virtual/bootloader ?= "u-boot-hardkernel"
PREFERRED_PROVIDER_u-boot ?= "u-boot-hardkernel"
PREFERRED_VERSION_u-boot-hardkernel ?= "2015.01"

KERNEL_IMAGETYPE ?= "Image"
UBOOT_BINARY ?= "u-boot.bin"
UBOOT_MACHINE_odroidc2 = "odroidc2_defconfig"

MACHINE_FEATURES = "serial usbgadget fb usbhost vfat ext2 rtc alsa legacykernel nolcd"
```

## conf/machine/odroidxu3.conf
```bitbake
#@TYPE: Machine
#@NAME: ODROID-UX3
#@DESCRIPTION: Machine configuration for ODROID-UX3

DEFAULTTUNE = "cortexa15hf-neon"
include conf/machine/include/tune-cortexa15.inc

PREFERRED_PROVIDER_virtual/xserver ?= "xserver-xorg"
XSERVER ?= "xserver-xorg \
           xf86-input-evdev \
           xf86-input-mouse \
           xf86-video-fbdev \
           xf86-input-keyboard"

MACHINE_EXTRA_RRECOMMENDS += " \
        kernel-modules \
	kernel-devicetree \
        "

EXTRA_IMAGEDEPENDS += "u-boot secure-odroidxu3 u-boot-config"

IMAGE_FSTYPES_append += "ext4 sdcard"

SERIAL_CONSOLE = "115200 ttySAC2"

PREFERRED_PROVIDER_virtual/kernel ?= "linux-stable"
PREFERRED_VERSION_linux-stable ?= "4.8%"

#specify u-boot parameters
PREFERRED_PROVIDER_virtual/bootloader ?= "u-boot"
PREFERRED_PROVIDER_u-boot ?= "u-boot"
PREFERRED_VERSION_u-boot ?= "v2016.03%"
UBOOT_MACHINE_odroidxu3 = "odroid-xu3_defconfig"

KERNEL_IMAGETYPE ?= "zImage"
KERNEL_DEVICETREE ?= "exynos5422-odroidxu3.dtb"
UBOOT_BINARY ?= "u-boot-dtb.bin"

MACHINE_FEATURES = "serial usbgadget usbhost vfat ext2 rtc alsa screen"
```

## conf/machine/s805.conf
```bitbake
# Amlogic S805 boards

require conf/machine/include/amlogic-s805.inc

KERNEL_DEVICETREE += "meson8b-odroidc1.dtb"
IMAGE_BOOT_FILES += "Image-meson8b-odroidc1.dtb;meson8b-odroidc1.dtb"
```

## conf/machine/s905.conf
```bitbake
# Amlogic S905 boards

require conf/machine/include/amlogic-s905.inc

KERNEL_DEVICETREE += "amlogic/meson-gxbb-p200.dtb"
IMAGE_BOOT_FILES += "Image-meson-gxbb-p200.dtb;meson-gxbb-p200.dtb"

KERNEL_DEVICETREE += "amlogic/meson-gxbb-p201.dtb"
IMAGE_BOOT_FILES += "Image-meson-gxbb-p201.dtb;meson-gxbb-p201.dtb"

KERNEL_DEVICETREE += "amlogic/meson-gxbb-odroidc2.dtb"
IMAGE_BOOT_FILES += "Image-meson-gxbb-odroidc2.dtb;meson-gxbb-odroidc2.dtb"

KERNEL_DEVICETREE += "amlogic/meson-gxbb-vega-s95-meta.dtb"
IMAGE_BOOT_FILES += "Image-meson-gxbb-vega-s95-meta.dtb;meson-gxbb-vega-s95-meta.dtb"

KERNEL_DEVICETREE += "amlogic/meson-gxbb-vega-s95-pro.dtb"
IMAGE_BOOT_FILES += "Image-meson-gxbb-vega-s95-pro.dtb;meson-gxbb-vega-s95-pro.dtb"

KERNEL_DEVICETREE += "amlogic/meson-gxbb-vega-s95-telos.dtb"
IMAGE_BOOT_FILES += "Image-meson-gxbb-vega-s95-telos.dtb;meson-gxbb-vega-s95-telos.dtb"

KERNEL_DEVICETREE += "amlogic/meson-gxbb-nexbox-a95x.dtb"
IMAGE_BOOT_FILES += "Image-meson-gxbb-nexbox-a95x.dtb;meson-gxbb-nexbox-a95x.dtb"

KERNEL_DEVICETREE += "amlogic/meson-gxbb-nexbox-a95x.dtb"
IMAGE_BOOT_FILES += "Image-meson-gxbb-nexbox-a95x.dtb;meson-gxbb-nexbox-a95x.dtb"

KERNEL_DEVICETREE += "amlogic/meson-gxbb-wetek-play2.dtb"
IMAGE_BOOT_FILES += "Image-meson-gxbb-wetek-play2.dtb;meson-gxbb-wetek-play2.dtb"
```

## conf/machine/s905d.conf
```bitbake
# Amlogic S905D boards

require conf/machine/include/amlogic-s905d.inc

KERNEL_DEVICETREE += "amlogic/meson-gxl-s905d-p230.dtb"
IMAGE_BOOT_FILES += "Image-meson-gxl-s905d-p230.dtb;meson-gxl-s905d-p230.dtb"

KERNEL_DEVICETREE += "amlogic/meson-gxl-s905d-p231.dtb"
IMAGE_BOOT_FILES += "Image-meson-gxl-s905d-p231.dtb;meson-gxl-s905d-p231.dtb"
```

## conf/machine/s905x.conf
```bitbake
# Amlogic S905X boards

require conf/machine/include/amlogic-s905x.inc

KERNEL_DEVICETREE += "amlogic/meson-gxl-s905x-p212.dtb"
IMAGE_BOOT_FILES += "Image-meson-gxl-s905x-p212.dtb;meson-gxl-s905x-p212.dtb"

KERNEL_DEVICETREE += "amlogic/meson-gxl-s905x-nexbox-a95x.dtb"
IMAGE_BOOT_FILES += "Image-meson-gxl-s905x-nexbox-a95x.dtb;meson-gxl-s905x-nexbox-a95x.dtb"

KERNEL_DEVICETREE += "amlogic/meson-gxl-s905x-khadas-vim.dtb"
IMAGE_BOOT_FILES += "Image-meson-gxl-s905x-khadas-vim.dtb;meson-gxl-s905x-khadas-vim.dtb"

KERNEL_DEVICETREE += "amlogic/meson-gxl-s905x-hwacom-amazetv.dtb"
IMAGE_BOOT_FILES += "Image-meson-gxl-s905x-hwacom-amazetv.dtb;meson-gxl-s905x-hwacom-amazetv.dtb"

KERNEL_DEVICETREE += "amlogic/meson-gxl-s905x-libretech-cc.dtb"
IMAGE_BOOT_FILES += "Image-meson-gxl-s905x-libretech-cc.dtb;meson-gxl-s905x-libretech-cc.dtb"
```

## conf/machine/s912.conf
```bitbake
# Amlogic S912 boards

require conf/machine/include/amlogic-s912.inc

KERNEL_DEVICETREE += "amlogic/meson-gxm-q200.dtb"
IMAGE_BOOT_FILES += "Image-meson-gxm-q200.dtb;meson-gxm-q200.dtb"

KERNEL_DEVICETREE += "amlogic/meson-gxm-q201.dtb"
IMAGE_BOOT_FILES += "Image-meson-gxm-q201.dtb;meson-gxm-q201.dtb"

KERNEL_DEVICETREE += "amlogic/meson-gxm-nexbox-a1.dtb"
IMAGE_BOOT_FILES += "Image-meson-gxm-nexbox-a1.dtb;meson-gxm-nexbox-a1.dtb"

KERNEL_DEVICETREE += "amlogic/meson-gxm-khadas-vi2.dtb"
IMAGE_BOOT_FILES += "Image-meson-gxm-khadas-vim2.dtb;meson-gxm-khadas-vim2.dtb"
```
