## conf/machine/s9xxx.conf
```bitbake
# Amlogic S905/S905X/S905D/S912 boards

require conf/machine/include/amlogic-s9xxx.inc

KERNEL_DEVICETREE += "amlogic/meson-gxbb-p200.dtb"
IMAGE_BOOT_FILES += "Image-meson-gxbb-p200.dtb;meson-gxbb-p200.dtb"

KERNEL_DEVICETREE += "amlogic/meson-gxbb-p201.dtb"
IMAGE_BOOT_FILES += "Image-meson-gxbb-p201.dtb;meson-gxbb-p201.dtb"

KERNEL_DEVICETREE += "amlogic/meson-gxbb-odroidc2.dtb"
IMAGE_BOOT_FILES += "Image-meson-gxbb-odroidc2.dtb;meson-gxbb-odroidc2.dtb"

KERNEL_DEVICETREE += "amlogic/meson-gxbb-vega-s95-meta.dtb"
IMAGE_BOOT_FILES += "Image-meson-gxbb-vega-s95-meta.dtb;meson-gxbb-vega-s95-meta.dtb"

KERNEL_DEVICETREE += "amlogic/meson-gxbb-vega-s95-pro.dtb"
IMAGE_BOOT_FILES += "Image-meson-gxbb-vega-s95-pro.dtb;meson-gxbb-vega-s95-pro.dtb"

KERNEL_DEVICETREE += "amlogic/meson-gxbb-vega-s95-telos.dtb"
IMAGE_BOOT_FILES += "Image-meson-gxbb-vega-s95-telos.dtb;meson-gxbb-vega-s95-telos.dtb"

KERNEL_DEVICETREE += "amlogic/meson-gxbb-nexbox-a95x.dtb"
IMAGE_BOOT_FILES += "Image-meson-gxbb-nexbox-a95x.dtb;meson-gxbb-nexbox-a95x.dtb"

KERNEL_DEVICETREE += "amlogic/meson-gxbb-nexbox-a95x.dtb"
IMAGE_BOOT_FILES += "Image-meson-gxbb-nexbox-a95x.dtb;meson-gxbb-nexbox-a95x.dtb"

KERNEL_DEVICETREE += "amlogic/meson-gxbb-wetek-play2.dtb"
IMAGE_BOOT_FILES += "Image-meson-gxbb-wetek-play2.dtb;meson-gxbb-wetek-play2.dtb"

KERNEL_DEVICETREE += "amlogic/meson-gxl-s905x-p212.dtb"
IMAGE_BOOT_FILES += "Image-meson-gxl-s905x-p212.dtb;meson-gxl-s905x-p212.dtb"

KERNEL_DEVICETREE += "amlogic/meson-gxl-s905x-nexbox-a95x.dtb"
IMAGE_BOOT_FILES += "Image-meson-gxl-s905x-nexbox-a95x.dtb;meson-gxl-s905x-nexbox-a95x.dtb"

KERNEL_DEVICETREE += "amlogic/meson-gxl-s905x-khadas-vim.dtb"
IMAGE_BOOT_FILES += "Image-meson-gxl-s905x-khadas-vim.dtb;meson-gxl-s905x-khadas-vim.dtb"

KERNEL_DEVICETREE += "amlogic/meson-gxl-s905x-hwacom-amazetv.dtb"
IMAGE_BOOT_FILES += "Image-meson-gxl-s905x-hwacom-amazetv.dtb;meson-gxl-s905x-hwacom-amazetv.dtb"

KERNEL_DEVICETREE += "amlogic/meson-gxl-s905x-libretech-cc.dtb"
IMAGE_BOOT_FILES += "Image-meson-gxl-s905x-libretech-cc.dtb;meson-gxl-s905x-libretech-cc.dtb"

KERNEL_DEVICETREE += "amlogic/meson-gxl-s905d-p230.dtb"
IMAGE_BOOT_FILES += "Image-meson-gxl-s905d-p230.dtb;meson-gxl-s905d-p230.dtb"

KERNEL_DEVICETREE += "amlogic/meson-gxl-s905d-p231.dtb"
IMAGE_BOOT_FILES += "Image-meson-gxl-s905d-p231.dtb;meson-gxl-s905d-p231.dtb"

KERNEL_DEVICETREE += "amlogic/meson-gxm-q200.dtb"
IMAGE_BOOT_FILES += "Image-meson-gxm-q200.dtb;meson-gxm-q200.dtb"

KERNEL_DEVICETREE += "amlogic/meson-gxm-q201.dtb"
IMAGE_BOOT_FILES += "Image-meson-gxm-q201.dtb;meson-gxm-q201.dtb"

KERNEL_DEVICETREE += "amlogic/meson-gxm-nexbox-a1.dtb"
IMAGE_BOOT_FILES += "Image-meson-gxm-nexbox-a1.dtb;meson-gxm-nexbox-a1.dtb"

KERNEL_DEVICETREE += "amlogic/meson-gxm-khadas-vi2.dtb"
IMAGE_BOOT_FILES += "Image-meson-gxm-khadas-vim2.dtb;meson-gxm-khadas-vim2.dtb"
```

## conf/machine/wetekhub.conf
```bitbake
#@TYPE: Machine
#@NAME: WeTeK Hub
#@DESCRIPTION: Machine configuration for WeTeK Hub

require conf/machine/include/wetek-common.inc

KERNEL_DEVICETREE = "gxbb_p200_1G_wetek_hub.dtb"
```

## conf/machine/wetekplay.conf
```bitbake
#@TYPE: Machine
#@NAME: WeTeK Play
#@DESCRIPTION: Machine configuration for WeTeK Play

SOC_FAMILY = "AML8726"

# Amlogic defaults
require conf/machine/include/wetek-amlogic.inc
# Uncomment the following line to enable the hard floating point abi. Note that
# this breaks some binary libraries and 3D (neither of which ship with
# meta-yocto). For maximum compatibility, leave this disabled.
DEFAULTTUNE ?= "cortexa9hf-neon"
include conf/machine/include/tune-cortexa9.inc
require conf/machine/include/soc-family.inc

MACHINE_ESSENTIAL_EXTRA_RDEPENDS += "\
    wetek-dvb-modules-${MACHINE} \
    gst-amlavsink \
    gst-app \
    gst-amlavout \
    gst-fluendo-mpegdemux \
    opengl-amlogic \
    "

MACHINE_ESSENTIAL_EXTRA_RRECOMMENDS += "\
    kernel-module-cdfs \
    kernel-module-sysfillrect \
    kernel-module-syscopyarea \
    kernel-module-mceusb \
    kernel-module-rc-core \
    kernel-module-mali \
    kernel-module-dhd \
    kernel-module-CH341 \
    amlsetfb \
    amremote \
    "

KERNEL_MODULE_AUTOLOAD += "\
    e2-procfs \
    sysfillrect \
    syscopyarea \
    mceusb \
    rc-core \
    mali \
    dhd \
    CH341 \
    rfcomm \
    hidp \
"

PREFERRED_PROVIDER_virtual/kernel = "linux-wetek"
PREFERRED_VERSION_linux-wetek = "3.10.93"

KERNEL_IMAGETYPE = "uImage-dtb"
KERNEL_DEVICETREE = "wetekplay.dtd"

MACHINE_FEATURES += "meson6"
```

## conf/machine/wetekplay2.conf
```bitbake
#@TYPE: Machine
#@NAME: WeTeK Play 2
#@DESCRIPTION: Machine configuration for WeTeK Play 2

require conf/machine/include/wetek-common.inc

KERNEL_DEVICETREE = "gxbb_p200_2G_wetek_play_2.dtb"
```

## conf/machine/x8hp.conf
```bitbake
#@TYPE: Machine
#@NAME: MINIX NEO X8-H Plus
#@DESCRIPTION: Machine configuration for MINIX NEO X8-H Plus

GST_VERSION = "0.10"

SOC_FAMILY = "aml8726"

# Amlogic defaults
require conf/machine/include/amlogic.inc

IMAGE_CLASSES += "image_types_minix"

MACHINE_ESSENTIAL_EXTRA_RDEPENDS = "\
    gst-amlavsink \
    gst-app \
    gst-amlavout \
    gst-fluendo-mpegdemux \
    opengl-amlogic \
    "

DVBPROVIDER = "kernel"

MACHINE_ESSENTIAL_EXTRA_RRECOMMENDS = "\
    kernel-module-cdfs \
    kernel-module-stb-procfs \
    kernel-module-stb-nimsockets \
    kernel-module-sysfillrect \
    kernel-module-syscopyarea \
    kernel-module-mceusb \
    kernel-module-rc-core \
    kernel-module-mali \
    kernel-module-dhd \
    kernel-module-CH341 \
    kernel-module-aml_pmu_dev \
    amlsetfb \
    amremote \
    firmware-ap6330 \
    "

MACHINE_EXTRA_RRECOMMENDS = " \
    libamplayer \
    libamavutils \
    libamadec \
    libamcodec \
    "

include conf/machine/include/autoload-filesystems.inc

KERNEL_MODULE_AUTOLOAD += "\
    stb-procfs \
    stb-nimsockets \
    sysfillrect \
    syscopyarea \
    mceusb \
    rc-core \
    mali \
    dhd \
    CH341 \
    rfcomm \
    hidp \
    aml_pmu_dev \
"

# Uncomment the following line to enable the hard floating point abi. Note that
# this breaks some binary libraries and 3D (neither of which ship with
# meta-yocto). For maximum compatibility, leave this disabled.
DEFAULTTUNE ?= "cortexa9hf-neon"
include conf/machine/include/tune-cortexa9.inc

IMAGE_FSTYPES += "ext4 sdcard"
IMAGE_ROOTFS_SIZE = "976562"
IMAGE_EXTRA_SPACE = "0"
IMAGE_OVERHEAD_FACTOR = "1.0"

# Serial console to be used
SERIAL_CONSOLE = "115200 ttyS0"

PREFERRED_PROVIDER_virtual/kernel = "linux-minix"
PREFERRED_VERSION_linux-wetek = "3.10.93"

KERNEL_IMAGETYPE = "uImage"
KERNEL_DEVICETREE = "meson8m2_n200_2G.dtd meson8m2_n200_2G.dtb"

#specify u-boot parameters
PREFERRED_PROVIDER_virtual/bootloader ?= "u-boot-hardkernel"
PREFERRED_PROVIDER_u-boot ?= "u-boot-hardkernel"
PREFERRED_VERSION_u-boot-hardkernel ?= "2015.01"

UBOOT_MACHINE_odroidc2 = "odroidc2_defconfig"

UBOOT_ENTRYPOINT  = "0x80008000"
UBOOT_LOADADDRESS = "0x80008000"

IMAGEDIR ?= "${MACHINE}"

IMAGE_CMD_sdcard_append = " \
    mkdir -p ${DEPLOY_DIR_IMAGE}/${IMAGEDIR}; \
    mv ${DEPLOY_DIR_IMAGE}/${IMAGE_NAME}.rootfs.minix-sd.img ${DEPLOY_DIR_IMAGE}/${IMAGEDIR}/${IMAGE_NAME}.sdcard.img; \
    echo ${IMAGE_VER_STRING} > ${DEPLOY_DIR_IMAGE}/${IMAGEDIR}/imageversion; \
    cd ${DEPLOY_DIR_IMAGE}; \
    zip ${IMAGE_NAME}_sdcard.zip ${IMAGEDIR}/*; \
    rm -f ${DEPLOY_DIR_IMAGE}/*.ext4; \
    rm -f ${DEPLOY_DIR_IMAGE}/*.manifest; \
    rm -f ${DEPLOY_DIR_IMAGE}/.ext4; \
    rm -f ${DEPLOY_DIR_IMAGE}/.manifest; \
    rm -f ${DEPLOY_DIR_IMAGE}/.minix-sd.img; \
    rm -f ${DEPLOY_DIR_IMAGE}/*.rootfs.minix-sd.img; \
    rm -Rf ${IMAGEDIR}; \
    "

MACHINE_FEATURES = "wlan bluetooth fb meson8 usbhost vfat alsa dvb-c legacykernel nolcd"

# We know about rtc
include conf/machine/include/build-extras.inc
```
